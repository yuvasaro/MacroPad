#include <Keyboard.h>
#include <SPI.h>
#include <Wire.h>
#include <Adafruit_GFX.h>
#include <Adafruit_SSD1306.h>

#define SCREEN_WIDTH 128
#define SCREEN_HEIGHT 64

#define OLED_RESET -1
#define SCREEN_ADDRESS 0x3C

Adafruit_SSD1306 display(SCREEN_WIDTH, SCREEN_HEIGHT, &Wire, OLED_RESET);

// 'Img1 Display1', 128x64px
const unsigned char im1d1_bmp [] PROGMEM = {
	0x00, 0x00, 0x00, 0x00, 0x00, 0x00, 0x00, 0x00, 0x00, 0x00, 0x00, 0x00, 0x00, 0x00, 0x00, 0x00, 
	0x00, 0x00, 0x00, 0x00, 0x00, 0x00, 0x00, 0x00, 0x00, 0x00, 0x00, 0x00, 0x00, 0x00, 0x00, 0x00, 
	0x00, 0x00, 0x00, 0x00, 0x00, 0x00, 0x00, 0x00, 0x00, 0x00, 0x00, 0x00, 0x00, 0x00, 0x00, 0x00, 
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	0x00, 0x00, 0x00, 0x00, 0x00, 0x00, 0x00, 0x00, 0x00, 0x00, 0x00, 0x00, 0x00, 0x00, 0x00, 0x00
};

// 'Img2 Display1', 128x64px
const unsigned char im2d1_bmp [] PROGMEM = {
	0x00, 0x00, 0x00, 0x00, 0x00, 0x00, 0x00, 0x00, 0x00, 0x00, 0x00, 0x00, 0x00, 0x00, 0x00, 0x00, 
	0x00, 0x00, 0x00, 0x00, 0x00, 0x00, 0x00, 0x00, 0x00, 0x00, 0x00, 0x00, 0x00, 0x00, 0x00, 0x00, 
	0x00, 0x00, 0x00, 0x00, 0x00, 0x00, 0x00, 0x00, 0x00, 0x00, 0x00, 0x00, 0x00, 0x00, 0x00, 0x00, 
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	0x00, 0x00, 0x00, 0x00, 0x00, 0x00, 0x00, 0x00, 0x00, 0x00, 0x00, 0x00, 0x00, 0x00, 0x00, 0x00
};

// 'Img1 Display2', 128x64px
const unsigned char im1d2_bmp [] PROGMEM = {
	0x00, 0x00, 0x00, 0x00, 0x00, 0x00, 0x00, 0x00, 0x00, 0x00, 0x00, 0x00, 0x00, 0x00, 0x00, 0x00, 
	0x00, 0x00, 0x00, 0x00, 0x00, 0x00, 0x00, 0x00, 0x00, 0x00, 0x00, 0x00, 0x00, 0x00, 0x00, 0x00, 
	0x07, 0xff, 0xff, 0xff, 0xff, 0xff, 0xff, 0xf0, 0x00, 0x00, 0x00, 0x00, 0x00, 0x00, 0x00, 0x00, 
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	0x00, 0x00, 0x00, 0x00, 0x00, 0x00, 0x00, 0x00, 0x00, 0x00, 0x00, 0x00, 0x00, 0x00, 0x00, 0x00
};

// 'Img2 Display2', 128x64px
const unsigned char im2d2_bmp [] PROGMEM = {
	0x00, 0x00, 0x00, 0x00, 0x00, 0x00, 0x00, 0x00, 0x00, 0x00, 0x00, 0x00, 0x00, 0x00, 0x00, 0x00, 
	0x00, 0x00, 0x00, 0x00, 0x00, 0x00, 0x00, 0x00, 0x00, 0x00, 0x00, 0x00, 0x00, 0x00, 0x00, 0x00, 
	0x00, 0x00, 0x00, 0x00, 0x00, 0x00, 0x00, 0x00, 0x00, 0x00, 0x00, 0x00, 0x00, 0x00, 0x00, 0x00, 
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	0x00, 0x00, 0x00, 0x00, 0x00, 0x00, 0x00, 0x00, 0x00, 0x00, 0x00, 0x00, 0x00, 0x00, 0x00, 0x00
};

// Array of all bitmaps for convenience. (Total bytes used to store images in PROGMEM = 1040)
const int myBitmapallArray_LEN = 4;
const unsigned char* myBitmapallArray[4] = {
	im1d1_bmp, im1d2_bmp, im2d1_bmp, im2d2_bmp
};

#define BUTTON1 4
#define BUTTON2 5
#define BUTTON3 6
#define BUTTON4 7

#define MODE_BUTTON 2


void setup() {
  // put your setup code here, to run once:

  display.begin(SSD1306_SWITCHCAPVCC, 0x3C);
  display.clearDisplay();

  display.print("Hello User!");
  display.drawBitmap(0, 0, im1d1_bmp, 128, 64, WHITE);
  display.display();
  
  pinMode(BUTTON1, INPUT_PULLUP);
  pinMode(BUTTON2, INPUT_PULLUP);
  pinMode(BUTTON3, INPUT_PULLUP);
  pinMode(BUTTON4, INPUT_PULLUP);

  
  pinMode(MODE_BUTTON, INPUT_PULLUP);

  Serial.begin(9600);

  Keyboard.begin();

}

void openSpotify()
{}

void openVSCode()
{}

void openArduino()
{
  //Serial.println("Arduino Opened");
  Keyboard.press(KEY_LEFT_CTRL);
  Keyboard.press(KEY_LEFT_ALT);
  Keyboard.press('a');
  Keyboard.releaseAll();
  delay(1000);
}

void openNotion()
{
  //Serial.println("Notion Opened");
  Keyboard.press(KEY_LEFT_CTRL);
  Keyboard.press(KEY_LEFT_ALT);
  Keyboard.press('n');
  Keyboard.releaseAll();
  delay(1000);
}

void openFifa()
{}

void openDiscord()
{}

void openGitHub()
{}

void nextTrack()
{}

void runAndDebug()
{}

void openTerminal()
{}

int profile = 0;
bool dset = true;

void loop() {
  // put your main code here, to run repeatedly:

  switch(profile)
  {
      case 0:
        if(digitalRead(BUTTON1) == 0){ openVSCode(); Serial.println("Button 1 Pressed - VSCode");}
        if(digitalRead(BUTTON2) == 0){ openArduino(); Serial.println("Button 2 Pressedc - Arduino");}
        if(digitalRead(BUTTON3) == 0){ openSpotify(); Serial.println("Button 3 Pressed - Spotify");}
        if(digitalRead(BUTTON4) == 0){ openNotion(); Serial.println("Button 4 Pressed - Notion");}

        delay(200);
        if(!dset)
        {
          display.clearDisplay();
          //im1d1 code
          display.drawBitmap(0, 0, im1d2_bmp, 128, 64, WHITE);
          display.display();
          dset = true;
        }
        break;
      case 1:
        if(digitalRead(BUTTON1) == 0){ openTerminal(); Serial.println("Button 1 Pressed - Terminal");}
        if(digitalRead(BUTTON2) == 0){ runAndDebug(); Serial.println("Button 2 Pressed - RunNDebug");}
        if(digitalRead(BUTTON3) == 0){ openGitHub(); Serial.println("Button 3 Pressed - GitHub");}
        if(digitalRead(BUTTON4) == 0){ nextTrack(); Serial.println("Button 4 Pressed - Skip");}

        delay(200);
        if(!dset)
        {
          display.clearDisplay();
          //im2d1 code
          display.drawBitmap(0, 0, im2d2_bmp, 128, 64, WHITE);
          display.display();
          dset = true;
        }
        break;
      default:
        break;
  }

  if(digitalRead(MODE_BUTTON) == 0)
  {
    Serial.println("Profile Switched");
    profile=(profile+1)%2;
    dset = false;
  }

}
